## CMakeLists.txt
```
# SPDX-License-Identifier: Apache-2.0 Copyright 2022 Martin Schröder
# <info@swedishembedded.com> Consulting: https://swedishembedded.com/go
# Training: https://swedishembedded.com/tag/training

cmake_minimum_required(VERSION 3.20.0)
find_package(Zephyr REQUIRED HINTS $ENV{ZEPHYR_BASE})
project(test)

if(CONFIG_CMOCK)
  unity_generate_test_runner(src/unit.c)
  # cmock_generate_mocks(${ZEPHYR_BASE}/include/zephyr/device.h .)
  cmock_generate_mocks(${ZEPHYR_BASE}/include/zephyr/kernel.h .)
  target_sources(app PRIVATE src/unit.c)
else()
  target_sources(
    app
    PRIVATE
      ${CMAKE_CURRENT_LIST_DIR}/../../../../drivers/example/example_driver.c)
  unity_generate_test_runner(src/integration.c)
  target_sources(app PRIVATE src/integration.c)
endif()
```

## prj.conf
```kconfig
# SPDX-License-Identifier: Apache-2.0
# Copyright 2022 Martin Schröder <info@swedishembedded.com>
# Consulting: https://swedishembedded.com/go
# Training: https://swedishembedded.com/tag/training

CONFIG_UNITY=y
CONFIG_ASSERT=n
CONFIG_TEST_LOGGING_DEFAULTS=n
```

## boards/custom_board.overlay
```dts
/* SPDX-License-Identifier: Apache-2.0 */
/**
 * Copyright 2022 Martin Schröder <info@swedishembedded.com>
 */
/ {
	example_driver {
		compatible = "example-driver";
		custom-variable = <1>;
		status = "okay";
	};
};
```

## boards/native_posix.overlay
```dts
/* SPDX-License-Identifier: Apache-2.0 */
/**
 * Copyright 2022 Martin Schröder <info@swedishembedded.com>
 * Consulting: https://swedishembedded.com/go
 * Training: https://swedishembedded.com/tag/training
 */

/ {
	example_driver {
		compatible = "example-driver";
		custom-variable = <1>;
		status = "okay";
	};
};
```

## src/integration.c
```c
// SPDX-License-Identifier: Apache-2.0
/**
 * Copyright 2022 Martin Schröder <info@swedishembedded.com>
 * Consulting: https://swedishembedded.com/go
 * Training: https://swedishembedded.com/tag/training
 **/

#include <example/example.h>
#include <unity.h>

void test_something_cool(void)
{
	TEST_ASSERT_EQUAL(0, 0);
}
```

## src/unit.c
```c
// SPDX-License-Identifier: Apache-2.0
/**
 * Copyright 2022 Martin Schröder <info@swedishembedded.com>
 * Consulting: https://swedishembedded.com/go
 * Training: https://swedishembedded.com/tag/training
 **/

#include "mock_kernel.h"

#include <cmock_unit.h>
#include <zephyr/device.h>
#include <example/example.h>
#include <unity.h>

#include "../../../../../drivers/example/example_driver.c"

void test_example_driver_init_should_return_einval_on_invalid_args(void)
{
	TEST_ASSERT_EQUAL(-EINVAL, example_driver_init(NULL));
}

void test_example_driver_init_should_initialize_driver(void)
{
	struct example_driver ex;
	struct example_driver_config conf;
	struct device dev = { .data = &ex, .config = &conf };

	TEST_ASSERT_EQUAL(0, example_driver_init(&dev));
}
```
