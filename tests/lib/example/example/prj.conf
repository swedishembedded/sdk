## CMakeLists.txt
```
# SPDX-License-Identifier: Apache-2.0 Copyright (c) 2022 Martin Schröder
# <info@swedishembedded.com> Consulting: https://swedishembedded.com/go
# Training: https://swedishembedded.com/tag/training

cmake_minimum_required(VERSION 3.20.0)
find_package(Zephyr REQUIRED HINTS $ENV{ZEPHYR_BASE})
project(test)

if(CONFIG_CMOCK)
  unity_generate_test_runner(src/unit.c)
  cmock_generate_mocks(${ZEPHYR_BASE}/include/zephyr/kernel.h .)
  target_sources(app PRIVATE src/unit.c)
else()
  target_sources(
    app PRIVATE ${CMAKE_CURRENT_LIST_DIR}/../../../../lib/example/example.c)
  unity_generate_test_runner(src/integration.c)
  target_sources(app PRIVATE src/integration.c)
endif()
```

## prj.conf
```kconfig
# SPDX-License-Identifier: Apache-2.0
# Copyright (c) 2022 Martin Schröder <info@swedishembedded.com>
# Consulting: https://swedishembedded.com/go
# Training: https://swedishembedded.com/tag/training

CONFIG_POLL=y
CONFIG_UNITY=y
```

## src/integration.c
```c
/*
 * Copyright (c) 2022 Martin Schröder Consulting
 *
 * SPDX-License-Identifier: Apache-2.0
 */

#include <example/example.h>

void main(void)
{
	// empty for now
}
```

## src/unit.c
```c
// SPDX-License-Identifier: Apache-2.0
/**
 * Copyright 2022 Martin Schröder <info@swedishembedded.com>
 * Consulting: https://swedishembedded.com/go
 * Training: https://swedishembedded.com/tag/training
 **/

#include "mock_kernel.h"

#include <unity.h>
#include <example/example.h>

// this is a unit test so we will include the file directly
// this is the only place where we do this - it is the optimal solution.
#include "../../../../../lib/example/example.c"

void test_example_object_init_should_return_einval_on_invalid_args(void)
{
	TEST_ASSERT_EQUAL(-EINVAL, example_object_init(NULL));
}

void test_example(void)
{
	struct example_object ex;

	__wrap_k_mutex_init_ExpectAndReturn(&ex.mx, 0);
	TEST_ASSERT_EQUAL(0, example_object_init(&ex));
}
```
