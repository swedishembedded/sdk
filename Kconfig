## Kconfig
```kconfig
# SPDX-License-Identifier: Apache-2.0
# Copyright (c) 2022 Martin Schröder <info@swedishembedded.com>
# Consulting: https://swedishembedded.com/go
# Training: https://swedishembedded.com/tag/training

rsource "drivers/Kconfig"
rsource "lib/Kconfig"
rsource "testbench/Kconfig"
```

## cmake/Kconfig
```kconfig
# SPDX-License-Identifier: Apache 2.0
# Copyright 2022 Martin Schröder <info@swedishembedded.com>
# Consulting: https://swedishembedded.com/go
# Training: https://swedishembedded.com/tag/training

config CHECK_CLANG_TIDY
	bool "Check sources using clang-tidy"
	default y
```

## drivers/Kconfig
```kconfig
# SPDX-License-Identifier: Apache 2.0
# Copyright 2022 Martin Schröder <info@swedishembedded.com>

menu "Device Drivers"

rsource "example/Kconfig"

rsource "gpio/Kconfig"

endmenu
```

## drivers/example/Kconfig
```kconfig
# SPDX-License-Identifier: Apache 2.0
# Copyright 2022 Martin Schröder <info@swedishembedded.com>
# Consulting: https://swedishembedded.com/go
# Training: https://swedishembedded.com/tag/training

config EXAMPLE_DRIVER
	bool "Example driver"
	help
		This is our example driver.

config EXAMPLE_SENSOR
	bool "Example sensor"
	help
		This is our example sensor.
```

## drivers/gpio/Kconfig.mcp23s17
```kconfig
config GPIO_MCP23S17V2
	bool "MCP23S17 SPI-based GPIO chip"
	depends on SPI
	select HAS_DTS_GPIO
	help
		Enable driver for MCP23S17 SPI-based GPIO chip.
```

## dts/bindings/example-driver.yaml
```yaml
# SPDX-License-Identifier: Apache-2.0
# Copyright 2022 Martin Schröder <info@swedishembedded.com>
# Consulting: https://swedishembedded.com/go
# Training: https://swedishembedded.com/tag/training

description: |
    Device tree bindings for the example driver.

    Example definition in devicetree:

    example_driver {
        compatible = "example-driver";
        custom-variable = <1>;
        status = "okay";
    };

compatible: "example-driver"

include: base.yaml

properties:
  custom-variable:
    type: int
    required: true
    description: A custom variable
```

## dts/bindings/example-sensor.yaml
```yaml
# SPDX-License-Identifier: Apache-2.0
# Copyright 2022 Martin Schröder <info@swedishembedded.com>
# Consulting: https://swedishembedded.com/go
# Training: https://swedishembedded.com/tag/training

description: |
    Device tree bindings for the example sensor.

    Example definition in devicetree:

    &spi1 {
        pinctrl-0 = <&spi1_sck_pa5 &spi1_miso_pa6 &spi1_mosi_pa7>;
        pinctrl-names = "default";
        cs-gpios = <&gpiob 6 (GPIO_ACTIVE_LOW | GPIO_PULL_UP)>;
        status = "okay";

        example_sensor: example_sensor@0{
            reg = <0>;
            compatible = "example-sensor";
            label = "EXAMPLE_SENSOR";
            gpios = <&gpioa 4 GPIO_ACTIVE_LOW>;
            spi-max-frequency = <1000000>;
            status = "okay";
        };
    };

compatible: "example-sensor"

include: [ "base.yaml", "spi-device.yaml" ]

properties:
  gpios:
    type: phandle-array
    required: true
    description: GPIO connected to the sensor
  label:
    required: true
    type: string
    description: Driver label
```

## dts/bindings/gpio/microchip,mcp23s17.yaml
```yaml
# SPDX-License-Identifier: Apache-2.0
# Copyright (c) 2020 Geanix ApS
# Copyright (c) 2022 Swedish Embedded Group AB
# Consulting: https://swedishembedded.com/go
# Training: https://swedishembedded.com/tag/training

description: |
  This is a representation of the Microchip MCP23S17 SPI Gpio Expander.

compatible: "microchip,mcp23s17v2"

include: [gpio-controller.yaml, spi-device.yaml]

properties:
  "#gpio-cells":
    const: 2

  ngpios:
    type: int
    required: true
    const: 16
    description: Number of gpios supported
  inta-gpios:
    type: phandle-array
    description: Interrupt for PORTA
  intb-gpios:
    type: phandle-array
    description: Interrupt for PORTB

gpio-cells:
  - pin
  - flags
```

## lib/Kconfig
```kconfig
# SPDX-License-Identifier: Apache 2.0
# Copyright 2022 Martin Schröder <info@swedishemebdded.com>
# Consulting: https://swedishembedded.com/go
# Training: https://swedishembedded.com/tag/training

rsource "example/Kconfig"
rsource "renode/Kconfig"
```

## lib/example/Kconfig
```kconfig
# Copyright (c) 2022 Martin Schröder
# SPDX-License-Identifier: Apache-2.0
# Consulting: https://swedishembedded.com/go
# Training: https://swedishembedded.com/tag/training

config EXAMPLE_LIBRARY
	bool "Example library"
	help
		Example library
```

## lib/renode/Kconfig
```kconfig
# Copyright (c) 2022 Martin Schröder
# SPDX-License-Identifier: Apache-2.0
# Consulting: https://swedishembedded.com/go
# Training: https://swedishembedded.com/tag/training

config RENODE
	bool "Renode integration functionality"
	help
		This provides ability of the application to communicate with renode machine.
		It is intended primarily for simulation development.
```

## modules/Kconfig
```kconfig
# SPDX-License-Identifier: Apache-2.0
# Copyright 2022 Martin Schröder <info@swedishembedded.com>
# Consulting: https://swedishembedded.com/go
# Training: https://swedishembedded.com/tag/training

menu "Unity/CMock"
rsource "unity/Kconfig"
rsource "cmock/Kconfig"
endmenu
```

## modules/cmock/Kconfig
```kconfig
config CMOCK
	bool "Use CMock mocking framework"
	select TEST
	depends on UNITY
	help
			This option enables CMock testing.
```

## modules/unity/Kconfig
```kconfig
# SPDX-License-Identifier: Apache-2.0
# Copyright 2022 Martin Schröder <info@swedishembedded.com>

config UNITY
	bool "Use Unity unit test framework"
	select TEST
	depends on !ZTEST
	help
			This enables unity test framework which you should use instead of ZTEST.
```

## samples/example/sample.yaml
```yaml
sample:
  name: Example sample
tests:
  samples.example.release:
    build_only: true
    integration_platforms:
      - native_posix
      - custom_board
```

## testbench/Kconfig
```kconfig
choice TESTBENCH
	prompt "Testbench"
	default TESTBENCH_NUCLEO401RE_MCP23S17

config TESTBENCH_NUCLEO401RE_MCP23S17
	bool "Nucleo401re browser based testbench"
	help
		"Browser based testbench for testing the firmware"

endchoice
```

## tests/Kconfig
```kconfig
# SPDX-License-Identifier: Apache-2.0
# Copyright (c) 2022 Martin Schröder <info@swedishembedded.com>
# Consulting: https://swedishembedded.com/go
# Training: https://swedishembedded.com/tag/training

menuconfig PLACEHOLDER
	bool "Dummy option"
	help
		This is a dummy option to make tests pass
```

## tests/drivers/example/example_driver/testcase.yaml
```yaml
# SPDX-License-Identifier: Apache-2.0
# Copyright (c) 2022 Martin Schröder <info@swedishembedded.com>

tests:
  drivers.example.example_driver.unit:
    tags: drivers/example/example_driver.c
    extra_configs:
      - CONFIG_CMOCK=y
    integration_platforms:
      - native_posix
  drivers.example.example_driver.integration:
    tags: drivers/example/example_driver.c
    integration_platforms:
      - native_posix
```

## tests/drivers/example/example_sensor/testcase.yaml
```yaml
# SPDX-License-Identifier: Apache-2.0
# Copyright 2022 Martin Schröder <info@swedishembedded.com>
# Consulting: https://swedishembedded.com/go
# Training: https://swedishembedded.com/tag/training

tests:
  drivers.example.example_sensor.unit:
    tags: drivers/example/example_sensor.c
    extra_configs:
      - CONFIG_CMOCK=y
    integration_platforms:
      - native_posix
  drivers.example.example_sensor.integration:
    tags: drivers/example/example_sensor.c
    build_only: true
    integration_platforms:
      - custom_board
```

## tests/drivers/gpio/mcp23s17/testcase.yaml
```yaml
tests:
  drivers.gpio.mcp23s17.unit:
    tags: drivers/gpio/mcp23s17.c
    extra_configs:
      - CONFIG_CMOCK=y
    platform_allow: native_posix
    integration_platforms:
      - native_posix
  drivers.gpio.mcp23s17.integration:
    tags: drivers/gpio/mcp23s17.c
    integration_platforms:
      - custom_board
```

## tests/lib/example/example/testcase.yaml
```yaml
# SPDX-License-Identifier: Apache-2.0
# Copyright (c) 2022 Martin Schröder <info@swedishembedded.com>
# Consulting: https://swedishembedded.com/go
# Training: https://swedishembedded.com/tag/training

tests:
  lib.example.example.unit:
    tags: lib/example/example.c
    extra_configs:
      - CONFIG_CMOCK=y
    integration_platforms:
      - native_posix
  lib.example.example.integration:
    tags: lib/example/example.c
    integration_platforms:
      - native_posix
```

## tests/lib/renode/renode/testcase.yaml
```yaml
# SPDX-License-Identifier: Apache-2.0
# Copyright (c) 2022 Martin Schröder <info@swedishembedded.com>

tests:
  lib.renode.renode.unit:
    tags: lib/renode/renode.c
    integration_platforms:
      - native_posix
  lib.renode.renode.integration:
    tags: lib/renode/renode.c
    integration_platforms:
      - native_posix
```

## west.yml
```yaml
# SPDX-License-Identifier: Apache-2.0

manifest:
  self:
    path: sdk
    west-commands: scripts/west-commands.yml

  remotes:
    - name: swedishembedded
      url-base: https://github.com/swedishembedded
    - name: zephyr
      url-base: https://github.com/zephyrproject-rtos
    - name: renode
      url-base: https://github.com/renode
  projects:
    - name: workstation
      remote: swedishembedded
      revision: v0.26.4-0
      path: workstation
    - name: zephyr
      remote: zephyr
      revision: v3.4.0
      import: true
    - name: renode
      path: tools/renode
      revision: v1.13.1
      submodules: true
      remote: renode
    - name: renode-docs
      path: tools/renode/docs
      revision: master
      remote: renode
    - name: control
      path: modules/lib/control
      revision: v0.36.0
      remote: swedishembedded
    - name: instruments
      path: tools/instruments
      revision: v0.35.1
      remote: swedishembedded
    - name: testing
      path: modules/test/testing
      revision: fc85f31
      remote: swedishembedded
      import: true
```
