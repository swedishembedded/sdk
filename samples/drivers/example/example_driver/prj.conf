## CMakeLists.txt
```
# SPDX-License-Identifier: Apache-2.0
# ~~~
# Copyright (c) 2022 Martin Schröder <info@swedishembedded.com>
# Consulting: https://swedishembedded.com/go
# Training: https://swedishembedded.com/tag/training
# ~~~

cmake_minimum_required(VERSION 3.13.1)
find_package(Zephyr REQUIRED HINTS $ENV{ZEPHYR_BASE})
project(example_sensor)

target_sources(app PRIVATE src/main.c)

check_clang_tidy(app)
```

## sample.yaml
```
# SPDX-License-Identifier: Apache-2.0
# Copyright 2022 Martin Schröder <info@swedishembedded.com>
# Consulting: https://swedishembedded.com/go
# Training: https://swedishembedded.com/tag/training

sample:
  name: Example sensor sample
tests:
  samples.drivers.example.example_driver.release:
    build_only: true
    integration_platforms:
      - native_posix
      - custom_board
```

## prj.conf
```kconfig
# SPDX-License-Identifier: Apache-2.0
# Copyright 2022 Martin Schröder <info@swedishembedded.com>
# Consulting: https://swedishembedded.com/go
# Training: https://swedishembedded.com/tag/training

CONFIG_SHELL=n
CONFIG_LOG=y
CONFIG_EXAMPLE_DRIVER=y
CONFIG_EXAMPLE_LIBRARY=y
```

## boards/custom_board.overlay
```dts
/* SPDX-License-Identifier: Apache-2.0 */
/**
 * Copyright 2022 Martin Schröder <info@swedishembedded.com>
 * Consulting: https://swedishembedded.com/go
 * Training: https://swedishembedded.com/tag/training
 */
/ {
	example_driver {
		compatible = "example-driver";
		custom-variable = <1>;
		status = "okay";
	};
};
```

## src/main.c
```c
// SPDX-License-Identifier: Apache-2.0
/**
 * Copyright 2022 Martin Schröder <info@swedishembedded.com>
 * Consulting: https://swedishembedded.com/go
 * Training: https://swedishembedded.com/tag/training
 **/

#include <example/example.h>
#include <project_version.h>

#include <zephyr/device.h>
#include <zephyr/drivers/sensor.h>
#include <zephyr/kernel.h>

void main(void)
{
	printk("Sample started (v%s)\n", PROJECT_VERSION_STRING);
};
```
