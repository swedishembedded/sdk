## CMakeLists.txt
```
# SPDX-License-Identifier: Apache-2.0 Copyright (c) 2022 Martin Schröder
# <info@swedishembedded.com> Consulting: https://swedishembedded.com/go
# Training: https://swedishembedded.com/tag/training

cmake_minimum_required(VERSION 3.20.0)

find_package(Zephyr REQUIRED HINTS $ENV{ZEPHYR_BASE})
project(rust_basic)

add_subdirectory(rslib)

target_sources(app PRIVATE src/main.c)
target_link_libraries(app PRIVATE rust_lib)
```

## sample.yaml
```
# SPDX-License-Identifier: MIT
# Copyright (c) 2022 Martin Schröder <info@swedishembedded.com>
# Consulting: https://swedishembedded.com/go
# Training: https://swedishembedded.com/tag/training

sample:
  description: Rust Hello World sample
    application
  name: rust hello world
common:
    tags: introduction
    platform_allow: qemu_cortex_m3
    integration_platforms:
      - qemu_cortex_m3
    harness: console
    harness_config:
      type: one_line
      regex:
        - "Message from RUST: Hello World! (.*)"
tests:
  sample.rust.basic:
    tags: introduction
```

## prj.conf
```kconfig
# SPDX-License-Identifier: Apache-2.0
# Copyright (c) 2022 Martin Schröder <info@swedishembedded.com>
# Consulting: https://swedishembedded.com/go
# Training: https://swedishembedded.com/tag/training

# nothing here
```

## src/main.c
```c
// SPDX-License-Identifier: Apache-2.0
/**
 * Copyright 2022 Martin Schröder <info@swedishembedded.com>
 * Consulting: https://swedishembedded.com/go
 * Training: https://swedishembedded.com/tag/training
 **/

#include <zephyr/kernel.h>

void print_message_from_rust(void);

void print_message_from_c(void)
{
	printk("Message from C: Hello World! %s\n", CONFIG_BOARD);
}

void main(void)
{
	print_message_from_rust();
}
```
