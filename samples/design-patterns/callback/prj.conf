## CMakeLists.txt
```
# SPDX-License-Identifier: Apache-2.0 Copyright (c) 2022 Martin Schröder
# <info@swedishembedded.com> Consulting: https://swedishembedded.com/go
# Training: https://swedishembedded.com/tag/training

cmake_minimum_required(VERSION 3.20.0)

find_package(Zephyr REQUIRED HINTS $ENV{ZEPHYR_BASE})
project(sample)

target_sources(app PRIVATE src/main.c src/button.c)
```

## sample.yaml
```
# SPDX-License-Identifier: Apache-2.0
# Copyright (c) 2022 Martin Schröder <info@swedishembedded.com>
# Consulting: https://swedishembedded.com/go
# Training: https://swedishembedded.com/tag/training

sample:
  name: Opaque Pattern
tests:
  samples.patterns.callback:
    platform_allow: qemu_cortex_m3
    build_only: true
    integration_platforms:
      - qemu_cortex_m3
      - qemu_x86_64
```

## prj.conf
```kconfig
# SPDX-License-Identifier: Apache-2.0
# Copyright (c) 2022 Martin Schröder <info@swedishembedded.com>
# Consulting: https://swedishembedded.com/go
# Training: https://swedishembedded.com/tag/training

CONFIG_ASSERT=y
CONFIG_MINIMAL_LIBC_MALLOC_ARENA_SIZE=128
```

## src/main.c
```c
// SPDX-License-Identifier: Apache-2.0
/**
 * Copyright 2022 Martin Schröder <info@swedishembedded.com>
 * Consulting: https://swedishembedded.com/go
 * Training: https://swedishembedded.com/tag/training
 **/

#include <zephyr/kernel.h>
#include <zephyr/sys/check.h>
#include <zephyr/sys/dlist.h>
#include <assert.h>
#include <string.h>
#include "button.h"

struct controller {
	/** Button instance */
	struct button *btn;
	/** Button callback */
	struct button_callback cb; // our callback
};

static void controller_on_button_cb(struct button_callback *cb)
{
	// this is how we can now get pointer to instance of B
	// notice that the callback is generic
	struct controller *self = CONTAINER_OF(cb, struct controller, cb);

	printk("Controller callback for button %p\n", self->btn);
}

void controller_init(struct controller *self, struct button *a)
{
	self->btn = a;
	self->cb.cb = controller_on_button_cb;
	/* Alternative 1 */
	button_set_callback(a, &self->cb);
	/* Alternative 2 */
	button_add_callback(a, &self->cb);
}

void controller_deinit(struct controller *self)
{
	/* Alternative 1 */
	button_remove_callback(self->btn, &self->cb);
	/* Alternative 2 */
	button_delete_callback(self->btn, &self->cb);
}

void main(void)
{
	struct controller ctrl;
	struct button btn;

	button_init(&btn);
	controller_init(&ctrl, &btn);

	// this will call controller callback function
	button_do_something(&btn);

	controller_deinit(&ctrl);
	button_deinit(&btn);
}
```

## src/button.c
```c
// SPDX-License-Identifier: Apache-2.0
/**
 * Copyright 2022 Martin Schröder <info@swedishembedded.com>
 * Consulting: https://swedishembedded.com/go
 * Training: https://swedishembedded.com/tag/training
 **/

#include "button.h"

#include <zephyr/sys/slist.h>
#include <string.h>

void button_init(struct button *self)
{
	memset(self, 0, sizeof(*self));
}

void button_deinit(struct button *self)
{
	self->cb = NULL;
}

size_t button_size(void)
{
	return sizeof(struct button);
}

void button_set_callback(struct button *self, struct button_callback *cb)
{
	self->cb = cb;
}

void button_remove_callback(struct button *self, struct button_callback *cb)
{
	self->cb = NULL;
}

void button_add_callback(struct button *self, struct button_callback *cb)
{
	sys_slist_append(&self->callbacks, &cb->node);
}

void button_delete_callback(struct button *self, struct button_callback *cb)
{
	sys_slist_find_and_remove(&self->callbacks, &cb->node);
}

void button_do_something(struct button *self)
{
	// call the callback
	if (self->cb)
		self->cb->cb(self->cb);

	sys_snode_t *node;

	SYS_SLIST_FOR_EACH_NODE (&self->callbacks, node) {
		// once again we use container of here since we know node points to cb->node
		struct button_callback *cb = CONTAINER_OF(node, struct button_callback, node);

		cb->cb(cb); // call the callback
	}
}
```

## src/button.h
```c
/* SPDX-License-Identifier: Apache-2.0 */
/**
 * Copyright 2022 Martin Schröder <info@swedishembedded.com>
 * Consulting: https://swedishembedded.com/go
 * Training: https://swedishembedded.com/tag/training
 **/

#include <zephyr/sys/slist.h>
#include <stddef.h>

struct button {
	/** Alternative 1: single callback */
	struct button_callback *cb;
	/** Alternative 2: multiple callbacks */
	sys_slist_t callbacks;
};

// this is a public callback definition
struct button_callback {
	sys_snode_t node;
	void (*cb)(struct button_callback *cb);
};

void button_init(struct button *self);
void button_deinit(struct button *self);
size_t button_size(void);
void button_set_callback(struct button *self, struct button_callback *cb);
void button_remove_callback(struct button *self, struct button_callback *cb);
void button_add_callback(struct button *self, struct button_callback *cb);
void button_delete_callback(struct button *self, struct button_callback *cb);
void button_do_something(struct button *self);
```
