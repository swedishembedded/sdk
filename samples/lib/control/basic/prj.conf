## CMakeLists.txt
```
# SPDX-License-Identifier: Apache-2.0
# Copyright (c) 2022 Martin Schröder <info@swedishembedded.com>
# Consulting: https://swedishembedded.com/go
# Training: https://swedishembedded.com/tag/training

cmake_minimum_required(VERSION 3.13.1)
find_package(Zephyr REQUIRED HINTS $ENV{ZEPHYR_BASE})
project(sample)

target_sources(app PRIVATE src/main.c)

# TODO: this needs to be made generic
set(LIB_CONTROL_ROOT ${PROJECT_BASE}/../modules/lib/control/)
set(LIB_IMGUI_ROOT ${PROJECT_BASE}/../modules/lib/imgui/)

add_custom_target(
  lqi-design.h
  COMMAND octave ${APPLICATION_SOURCE_DIR}/lqi-design.m >
          ${APPLICATION_BINARY_DIR}/lqi-design.h
  WORKING_DIRECTORY ${APPLICATION_SOURCE_DIR})

zephyr_include_directories(${APPLICATION_BINARY_DIR})

add_custom_target(
  peripheral
  COMMAND
    g++ `sdl2-config --cflags` -I${PROJECT_BASE}/include/
    -I${LIB_CONTROL_ROOT}/include -I${LIB_IMGUI_ROOT}
    -I${APPLICATION_BINARY_DIR}/ -I${LIB_IMGUI_ROOT}/backends/ -Wall -Wextra
    -Werror -o peripheral/peripheral.elf peripheral/main.cpp
    ${PROJECT_BASE}/lib/renode/renode.c ${LIB_IMGUI_ROOT}/imgui*.cpp
    ${LIB_IMGUI_ROOT}/backends/imgui_impl_sdl.cpp
    ${LIB_IMGUI_ROOT}/backends/imgui_impl_opengl3.cpp `sdl2-config --libs` -lGL
    -ldl
  DEPENDS ${APPLICATION_BINARY_DIR}/lqi-design.h
  WORKING_DIRECTORY ${APPLICATION_SOURCE_DIR})

add_dependencies(peripheral lqi-design.h)
add_dependencies(app peripheral)
```

## sample.yaml
```
# SPDX-License-Identifier: Apache-2.0
# Copyright (c) 2022 Martin Schröder <info@swedishembedded.com>
# Consulting: https://swedishembedded.com/go
# Training: https://swedishembedded.com/tag/training

sample:
  name: Control library sample
tests:
  samples.lib.control.basic:
    platform_allow: custom_board
    build_only: true
    integration_platforms:
      - custom_board
```

## prj.conf
```kconfig
# SPDX-License-Identifier: Apache-2.0
# Copyright 2022 Martin Schröder <info@swedishembedded.com>
# Consulting: https://swedishembedded.com/go
# Training: https://swedishembedded.com/tag/training

CONFIG_NEWLIB_LIBC=y
CONFIG_NEWLIB_LIBC_FLOAT_PRINTF=y
CONFIG_CONTROL=y
```

## src/main.c
```c
// SPDX-License-Identifier: Apache-2.0
/**
 * Copyright 2022 Martin Schröder <info@swedishembedded.com>
 *
 * Consulting: https://swedishembedded.com/go
 * Training: https://swedishembedded.com/tag/training
 *
 * This example shows how to execute an LQI controller within the context of
 * firmware, which communicates over a socket with a simulation connected to the
 * emulator.
 *
 * It is intentionally kept very raw and without dependencies because it is
 * intended to illustrate the core concept.
 *
 * We are writing to a raw memory location which is mapped by the simulator and
 * the data we write to it is passed to an external process. We can then read
 * data back and this data is also retrieved from an external process. Thus we
 * have a simulated plant that this controller stabilizes.
 **/

#include <kernel.h>
#include <stdint.h>
#include <stdio.h>
#include <string.h>
#include <float.h>
#include <control/dynamics.h>

#define ADIM 2
#define RDIM 1
#define YDIM 1
#define ANTI_WINDUP 0

/** Plant registers mapped by the simulation */
struct plant_controls {
	float u;
	float y;
	uint32_t compute;
	float r;
} __attribute__((packed)) __attribute__((aligned(4)));

static volatile struct plant_controls *plant = ((volatile struct plant_controls *)0x70000000);

#include <lqi-design.h>

void main(void)
{
	printk("Control library LQI sample\n");

	// Initial states - Normally set to zero
	float x[ADIM] = { 0 };
	float xi[1] = { 0 };

	// Input signal, reference signal, output signal and state vector x and xi
	float u[RDIM] = { 0 }; // <-- This is our controller output
	float y[YDIM] = { 0 }; // <-- This is error input

	while (1) {
		y[0] = -(plant->r - plant->y);

		//Control LQI
		lqi(u, L, x, Li, xi, y, ADIM, YDIM, RDIM, 0);

		// Estimate the state x
		kalman(x, A, x, B, u, K, y, C, ADIM, YDIM, RDIM);

		// Write control input to the plant
		plant->u = u[0];

		// This is used to trigger "tick" in the plant (since we are simulating)
		plant->compute = 1;

		// Print control input and output of the plant
		// The plant should stabilize at 'r'
		//printf("u = %f, y = %f\n", u[0], y[0]);
		k_sleep(K_MSEC(10));
	}
}
```
