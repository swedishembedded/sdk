## CMakeLists.txt
```
# SPDX-License-Identifier: Apache-2.0
# ~~~
# Copyright (c) 2022 Martin Schröder <info@swedishembedded.com>
# Consulting: https://swedishembedded.com/go
# Training: https://swedishembedded.com/tag/training
# ~~~

cmake_minimum_required(VERSION 3.13.1)
find_package(Zephyr REQUIRED HINTS $ENV{ZEPHYR_BASE})
project(sample)

configure_file(${CMAKE_CURRENT_SOURCE_DIR}/yosys.cfg.in
               ${CMAKE_CURRENT_BINARY_DIR}/yosys.cfg)
configure_file(${CMAKE_CURRENT_SOURCE_DIR}/formal.sby.in
               ${CMAKE_CURRENT_BINARY_DIR}/formal.sby)
execute_process(
  COMMAND yosys-config --datdir
  OUTPUT_STRIP_TRAILING_WHITESPACE
  OUTPUT_VARIABLE YOSYS_DATA_DIR)
message(${YOSYS_DATA_DIR}/include)
zephyr_include_directories(${YOSYS_DATA_DIR}/include)

add_custom_command(
  OUTPUT ${CMAKE_CURRENT_BINARY_DIR}/zephyr/include/generated/plc.hpp
  COMMENT "Generating C++ code from HDL..."
  COMMAND yosys -s ${CMAKE_CURRENT_BINARY_DIR}/yosys.cfg)

add_custom_target(
  formal
  COMMENT "Generating C++ code from HDL..."
  COMMAND sby -f ${CMAKE_CURRENT_BINARY_DIR}/formal.sby)

target_sources(
  app PRIVATE src/main.cpp
              ${CMAKE_CURRENT_BINARY_DIR}/zephyr/include/generated/plc.hpp)

add_dependencies(app formal)
```

## sample.yaml
```
# SPDX-License-Identifier: Apache-2.0
# Copyright (c) 2022 Martin Schröder <info@swedishembedded.com>
# Consulting: https://swedishembedded.com/go
# Training: https://swedishembedded.com/tag/training

sample:
  name: Verilog integration sample
tests:
  samples.hdl.verilog:
    build_only: true
    integration_platforms:
      - custom_board
      - native_posix
```

## prj.conf
```kconfig
# SPDX-License-Identifier: Apache-2.0
# Copyright 2022 Martin Schröder <info@swedishembedded.com>
# Consulting: https://swedishembedded.com/go
# Training: https://swedishembedded.com/tag/training

CONFIG_ASSERT=y
CONFIG_NEWLIB_LIBC=y
CONFIG_CPLUSPLUS=y
CONFIG_LIB_CPLUSPLUS=y
```

## src/main.cpp
```c
// SPDX-License-Identifier: Apache-2.0
/**
 * Copyright 2022 Martin Schröder <info@swedishembedded.com>
 *
 * Consulting: https://swedishembedded.com/go
 * Training: https://swedishembedded.com/tag/training
 **/

#include <zephyr/kernel.h>
#include <assert.h>
#include "plc.hpp"

using namespace std;

void tick(cxxrtl_design::p_plc &plc)
{
	plc.p_clk.set<bool>(false);
	plc.step();
	plc.p_clk.set<bool>(true);
	plc.step();
}

int main(void)
{
	cxxrtl_design::p_plc plc;

	plc.step();

	// initially everything should be off
	assert(plc.p_pump__1.get<bool>() == false);
	assert(plc.p_pump__2.get<bool>() == false);
	assert(plc.p_valve.get<bool>() == false);

	tick(plc);

	printk("! tank H_LEVEL: %d\n", plc.p_h__level.get<bool>());
	printk("! tank L_LEVEL: %d\n", plc.p_l__level.get<bool>());

	printk("=> filling up the tank\n");

	// when tank is empty, pumps must be active
	assert(plc.p_pump__1.get<bool>() == true);
	assert(plc.p_pump__2.get<bool>() == true);
	assert(plc.p_valve.get<bool>() == false);

	printk("=> tank level reached L_LEVEL\n");
	// tank has been filled to first level
	plc.p_l__level.set<bool>(true);
	tick(plc);

	printk("=> continuing filling up the tank\n");

	// tank pumps should still be active
	assert(plc.p_pump__1.get<bool>() == true);
	assert(plc.p_pump__2.get<bool>() == true);
	assert(plc.p_mixer.get<bool>() == false);
	assert(plc.p_valve.get<bool>() == false);

	// tank has been filled to upper level
	plc.p_h__level.set<bool>(true);
	tick(plc);

	printk("=> tank full\n");

	// pumps must be off
	assert(plc.p_pump__1.get<bool>() == false);
	assert(plc.p_pump__2.get<bool>() == false);
	assert(plc.p_mixer.get<bool>() == true);
	assert(plc.p_valve.get<bool>() == false);

	printk("=> mixing\n");

	for (int cycle = 0; cycle < 7000; ++cycle) {
		tick(plc);
	}

	printk("=> draining\n");

	// mixer must be off and valve should open
	assert(plc.p_pump__1.get<bool>() == false);
	assert(plc.p_pump__2.get<bool>() == false);
	assert(plc.p_mixer.get<bool>() == false);
	assert(plc.p_valve.get<bool>() == true);

	// level is down below upper
	plc.p_h__level.set<bool>(false);
	tick(plc);

	// continue to drain the tank
	assert(plc.p_pump__1.get<bool>() == false);
	assert(plc.p_pump__2.get<bool>() == false);
	assert(plc.p_mixer.get<bool>() == false);
	assert(plc.p_valve.get<bool>() == true);

	// level reached lower
	plc.p_l__level.set<bool>(false);
	tick(plc);

	printk("=> tank emptied\n");

	// pumps should start and valve is closed
	assert(plc.p_pump__1.get<bool>() == true);
	assert(plc.p_pump__2.get<bool>() == true);
	assert(plc.p_mixer.get<bool>() == false);
	assert(plc.p_valve.get<bool>() == false);

	printk("ALL CHECKS SUCCESSFUL!\n");

	return 0;
}
```
