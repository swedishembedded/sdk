## CMakeLists.txt
```
# SPDX-License-Identifier: Apache-2.0
# ~~~
# Copyright (c) 2021 Antmicro <www.antmicro.com>
# Consulting: https://swedishembedded.com/go
# Training: https://swedishembedded.com/tag/training
# ~~~

cmake_minimum_required(VERSION 3.13.1)
find_package(Zephyr REQUIRED HINTS $ENV{ZEPHYR_BASE})
project(shell)

target_sources(app PRIVATE src/main.c)
```

## sample.yaml
```
# SPDX-License-Identifier: Apache-2.0
# Copyright 2022 Martin Schröder <info@swedishembedded.com>
# Consulting: https://swedishembedded.com/go
# Training: https://swedishembedded.com/tag/training

sample:
  name: Example shell application
tests:
  apps.shell.release:
    build_only: true
    platform_allow: custom_board
    integration_platforms:
      - native_posix
      - custom_board
```

## prj.conf
```kconfig
# SPDX-License-Identifier: Apache-2.0
# Copyright 2022 Martin Schröder <info@swedishembedded.com>
# Consulting: https://swedishembedded.com/go
# Training: https://swedishembedded.com/tag/training

CONFIG_SHELL=y
CONFIG_EXAMPLE_LIBRARY=y
```

## boards/native_posix.overlay
```dts
/* SPDX-License-Identifier: Apache-2.0 */
/**
 * Copyright 2022 Martin Schröder <info@swedishembedded.com>
 * Consulting: https://swedishembedded.com/go
 * Training: https://swedishembedded.com/tag/training
 **/

/ {
	example_driver {
		compatible = "example-driver";
		custom-variable = <1>;
		status = "okay";
	};
};
```

## src/main.c
```c
// SPDX-License-Identifier: Apache-2.0
/**
 * Copyright (c) 2022 Martin Schröder <info@swedishembedded.com>
 * Consulting: https://swedishembedded.com/go
 * Training: https://swedishembedded.com/tag/training
 **/

#include <example/example.h>

#include <zephyr/kernel.h>

void main(void)
{
	struct example_object _ex;

	if (example_object_init(&_ex) != 0) {
		printk("Could not initialize example object\n");
	}
};
```
